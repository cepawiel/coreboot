## src/mainboard/lenovo/thinkcentre_m910q/Kconfig
```kconfig
# SPDX-License-Identifier: GPL-2.0-only

if BOARD_LENOVO_THINKCENTRE_M910Q

config BOARD_SPECIFIC_OPTIONS
	def_bool y
	select AZALIA_USE_LEGACY_VERB_TABLE
	select BOARD_ROMSIZE_KB_16384
	select DRIVERS_UART_8250IO
	select DRIVERS_USB_ACPI
	select HAVE_ACPI_RESUME
	select HAVE_ACPI_TABLES
	select INTEL_GMA_HAVE_VBT
	select MAINBOARD_HAS_LIBGFXINIT
	select MAINBOARD_HAS_TPM2
	select MAINBOARD_USES_IFD_GBE_REGION
	select MEMORY_MAPPED_TPM
	select SKYLAKE_SOC_PCH_H
	select SOC_INTEL_COMMON_BLOCK_HDA_VERB
	select SOC_INTEL_KABYLAKE
	select SUPERIO_NUVOTON_NCT6687D

config MAINBOARD_DIR
	default "lenovo/thinkcentre_m910q"

config MAINBOARD_PART_NUMBER
	default "ThinkCentre M910q"

config CBFS_SIZE
	default 0x7f0000

endif # BOARD_LENOVO_THINKCENTRE_M910Q
```

## src/mainboard/lenovo/thinkcentre_m910q/Kconfig.name
```kconfig
# SPDX-License-Identifier: GPL-2.0-only

config BOARD_LENOVO_THINKCENTRE_M910Q
	bool "ThinkCentre M910q"
```
